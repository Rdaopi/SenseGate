## CMakeLists.txt
```
cmake_minimum_required(VERSION 3.20.0)
find_package(Zephyr REQUIRED HINTS $ENV{ZEPHYR_BASE})
project(sensegate_collector)

zephyr_include_directories(include)
zephyr_include_directories(../lib)

target_sources(app PRIVATE
    src/main.c
    src/hal_ebyte_uart.c
    src/modbus_sim.c
    ../lib/aes_ctr.c
    ../lib/payload_packer.c
    ../lib/rolling_buffer.c
    ../lib/store_forward.c
    src/test_runner.c
)

# NUCLEO-L073RZ has 20 KB RAM: shrink the store-and-forward buffer
# (20 slots x 50 B = 1 KB instead of the 10 KB default sized for the RAK4631).
if(BOARD STREQUAL "nucleo_l073rz")
    target_compile_definitions(app PRIVATE SF_MAX_SLOTS=20)
endif()

# Bake current Unix timestamp so machine_timestamp reflects today's date.
# Uses Python (always available in the NCS toolchain) for reliable epoch output.
find_package(Python3 QUIET COMPONENTS Interpreter)
if(Python3_FOUND)
    execute_process(
        COMMAND ${Python3_EXECUTABLE} -c "import time; print(int(time.time()))"
        OUTPUT_VARIABLE SIM_BUILD_TS
        OUTPUT_STRIP_TRAILING_WHITESPACE
    )
else()
    set(SIM_BUILD_TS 1774138000)
endif()
message(STATUS "SenseGate sim base timestamp: ${SIM_BUILD_TS}")
target_compile_definitions(app PRIVATE SIM_BUILD_TS=${SIM_BUILD_TS}U)

# SIM_TX_INTERVAL_MS: ms between packets.
# Change this value and rebuild to adjust cadence.
# 2000 = 2s for testing, 300000 = 5min for production.
set(_tx_interval 10000)
message(STATUS "SenseGate TX interval: ${_tx_interval} ms")
target_compile_definitions(app PRIVATE SIM_TX_INTERVAL_MS=${_tx_interval}U)
```

## prj.conf
```kconfig
CONFIG_SERIAL=y
CONFIG_CONSOLE=y
CONFIG_UART_CONSOLE=y

# Stack sizes — default 1024 is too small for on_tx() call depth on real HW
CONFIG_MAIN_STACK_SIZE=4096
CONFIG_SYSTEM_WORKQUEUE_STACK_SIZE=2048

# Detect stack overflow in debug builds
CONFIG_STACK_SENTINEL=y

# Keep SWD alive while the core sleeps (k_msleep) — without this the
# ST-LINK fails target examination once the firmware is running
CONFIG_STM32_ENABLE_DEBUG_SLEEP_STOP=y

# Store-and-forward buffer: SF_MAX_SLOTS is reduced to 20 (1 KB) for the
# NUCLEO-L073RZ build via CMakeLists.txt (20 KB RAM total on this MCU).

# Ebyte E22-900T22S (UART transparent mode) on USART1 — see
# boards/nucleo_l073rz.overlay and src/hal_ebyte_uart.c.
# CONFIG_GPIO=y comes from the board defconfig (M0/M1/AUX pins).
# NOTE: CONFIG_LORA / CONFIG_LORA_SX12XX are NOT used: the T22S has its own
# firmware and is not a raw SPI SX1262 (that would be the E22-900M22S).

# Uncomment for a real Modbus RTU sensor (hal_hw.c). Also update CMakeLists.txt.
# CONFIG_MODBUS=y
# CONFIG_MODBUS_MASTER=y
# CONFIG_MODBUS_SERIAL=y
```

## boards/nucleo_l073rz.overlay
```dts
/*
 * NUCLEO-L073RZ overlay — Ebyte E22-900T22S on USART1
 *
 * The module's fixed config-mode baud rate is 9600 8N1; we keep the whole
 * link at 9600 so no baud switching is needed (50-byte frame = ~52 ms).
 *
 *   PA9  (CN10 pin 21, D8) -> E22 RXD
 *   PA10 (CN10 pin 33, D2) <- E22 TXD
 *
 * M0/M1/AUX are plain GPIOs on port C, configured in hal_ebyte_uart.c
 * (PC0 = M0, PC1 = M1, PC2 = AUX).
 *
 * The console stays on USART2 (PA2/PA3) through the ST-LINK VCP.
 */

&usart1 {
	pinctrl-0 = <&usart1_tx_pa9 &usart1_rx_pa10>;
	pinctrl-names = "default";
	current-speed = <9600>;
	status = "okay";
};
```

## src/main.c
```c
#include <zephyr/kernel.h>
#include <zephyr/sys/printk.h>
#include <string.h>
#include "hal.h"
#include "payload_packer.h"
#include "aes_ctr.h"
#include "rolling_buffer.h"
#include "store_forward.h"
#include "test_runner.h"

#define DEVICE_ID 1


static void on_tx(const hal_sensor_data_t *data,
                  uint16_t seq,
                  const char *scenario_name)
{
    printk("\n=========================================\n");
    printk("  TX #%u  [%s]\n", seq, scenario_name);
    printk("-----------------------------------------\n");
    printk("  INPUT (raw PLC data)\n");
    printk("  pallet_id:    %lu\n",   (unsigned long)data->pallet_id);
    printk("  wrap_time:    %u s\n",  data->wrap_time);
    printk("  wrap_transit: %u s\n",  data->wrap_transit_time);
    printk("  rotations:    %u\n",    data->pallet_rotations);
    printk("  program:      %u\n",    data->program_number);
    printk("  perimeter:    %u\n",    data->pallet_perimeter);
    printk("  running:      %lu s\n", (unsigned long)data->running_seconds);
    printk("  alarm:        %lu s\n", (unsigned long)data->alarm_seconds);
    printk("  timestamp:    %lu\n",   (unsigned long)data->machine_timestamp);
    printk("-----------------------------------------\n");

    /* 1. Pack */
    uint8_t payload[PAYLOAD_SIZE];
    pack_payload(payload,
                 data->state,
                 data->pallet_id,
                 data->wrap_time,
                 data->wrap_transit_time,
                 data->pallet_rotations,
                 data->program_number,
                 data->pallet_perimeter,
                 data->running_seconds,
                 data->alarm_seconds,
                 data->machine_timestamp,
                 seq,
                 DEVICE_ID);

    printk("  PACKED (%d bytes)\n  ", PAYLOAD_SIZE);
    for (int i = 0; i < PAYLOAD_SIZE; i++) printk("%02X", payload[i]);
    printk("\n-----------------------------------------\n");

    /* 2. Encrypt */
    uint8_t nonce[AES_NONCE_SIZE];
    hal_crypto_make_nonce(nonce, DEVICE_ID, seq);
    uint8_t ciphertext[PAYLOAD_SIZE];
    aes_ctr_crypt(nonce, payload, ciphertext, PAYLOAD_SIZE);

    printk("  ENCRYPTED AES-128-CTR (%d bytes)\n  ", PAYLOAD_SIZE);
    for (int i = 0; i < PAYLOAD_SIZE; i++) printk("%02X", ciphertext[i]);
    printk("\n-----------------------------------------\n");

    /* 3. Rolling redundancy */
    uint8_t tx_packet[SF_SLOT_SIZE];
    rolling_buffer_build(ciphertext, tx_packet);

    printk("  TX PACKET current+previous (%d bytes)\n", SF_SLOT_SIZE);
    printk("  [current]  ");
    for (int i = 0; i < PAYLOAD_SIZE; i++) printk("%02X", tx_packet[i]);
    printk("\n  [previous] ");
    for (int i = PAYLOAD_SIZE; i < SF_SLOT_SIZE; i++) printk("%02X", tx_packet[i]);
    printk("\n-----------------------------------------\n");

    /* 4. Store */
    int store_result = hal_flash_write(tx_packet, SF_SLOT_SIZE);
    if (store_result == SG_HAL_FULL) {
        printk("  BUFFER: FULL -- packet dropped\n");
    } else {
        printk("  BUFFER: stored (%d pending)\n", hal_flash_pending());
    }

    /* 5. TX */
    hal_radio_tx(tx_packet, SF_SLOT_SIZE);
    printk("=========================================\n\n");
}

int main(void)
{
    printk("\nSenseGate -- Data Collector Node\n");
    printk("==================================\n\n");

    if (hal_init() != SG_HAL_OK) {
        printk("FATAL: hal_init failed\n");
        return -1;
    }

    test_config_t cfg;
    test_runner_load(&cfg);
    test_runner_run(&cfg, on_tx);

    printk("\nDone. Buffer: %d pending\n", hal_flash_pending());
    return 0;
}
```

## include/hal.h
```c
#ifndef HAL_H
#define HAL_H

#include <stdint.h>
#include <stddef.h>
#include "payload_packer.h"
#include "rolling_buffer.h"

typedef struct {
    uint8_t  state;
    uint32_t pallet_id;
    uint16_t wrap_time;
    uint16_t wrap_transit_time;
    uint16_t pallet_rotations;
    uint8_t  program_number;
    uint16_t pallet_perimeter;
    uint32_t running_seconds;
    uint32_t alarm_seconds;
    uint32_t machine_timestamp;
} hal_sensor_data_t;

#define SG_HAL_OK      0
#define SG_HAL_ERROR  -1
#define SG_HAL_FULL   -2
#define SG_HAL_EMPTY  -3

int  hal_init(void);
int  hal_sensor_read(hal_sensor_data_t *data, uint16_t seq);
int  hal_flash_write(const uint8_t *packet, size_t len);
int  hal_flash_read(uint8_t *packet, size_t len);
int  hal_flash_pending(void);
int  hal_radio_tx(const uint8_t *packet, size_t len);
int  hal_crypto_get_key(uint8_t *key_out, size_t key_len);
void hal_crypto_make_nonce(uint8_t *nonce_out, uint8_t device_id, uint16_t seq);

#endif /* HAL_H */
```

## include/modbus_sim.h
```c
#ifndef MODBUS_SIM_H
#define MODBUS_SIM_H

#include <stdint.h>

/*
 * Modbus RTU slave simulator — emulates a Technowrapp PLC.
 *
 * Now:  simulated values in RAM
 * Later: real reads via MAX3485 + UART (Modbus FC 0x03)
 *
 * Register map (to be confirmed with Technowrapp):
 *   40001 — machine state code
 *   40002 — pallet_id HIGH word
 *   40003 — pallet_id LOW word
 *   40004 — wrap_time             (seconds)
 *   40005 — wrap_transit_time     (seconds)
 *   40006 — pallet_rotations
 *   40007 — program_number
 *   40008 — pallet_perimeter      (unit TBD with Technowrapp)
 *   40009 — running_seconds HIGH word
 *   40010 — running_seconds LOW word
 *   40011 — alarm_seconds HIGH word
 *   40012 — alarm_seconds LOW word
 *   40013 — timestamp HIGH word
 *   40014 — timestamp LOW word    (Unix epoch)
 */

#define MB_REG_STATE         0   /* 40001 */
#define MB_REG_PALLET_HIGH   1   /* 40002 */
#define MB_REG_PALLET_LOW    2   /* 40003 */
#define MB_REG_WRAP_TIME     3   /* 40004 */
#define MB_REG_WRAP_TRANSIT  4   /* 40005 */
#define MB_REG_ROTATIONS     5   /* 40006 */
#define MB_REG_PROGRAM       6   /* 40007 */
#define MB_REG_PERIMETER     7   /* 40008 */
#define MB_REG_RUN_HIGH      8   /* 40009 */
#define MB_REG_RUN_LOW       9   /* 40010 */
#define MB_REG_ALARM_HIGH   10   /* 40011 */
#define MB_REG_ALARM_LOW    11   /* 40012 */
#define MB_REG_TS_HIGH      12   /* 40013 */
#define MB_REG_TS_LOW       13   /* 40014 */
#define MB_NUM_REGS         14

void     modbus_sim_init(void);
int      modbus_sim_read_registers(uint16_t *regs, uint8_t count);
void     modbus_sim_tick(uint16_t seq);
uint32_t modbus_sim_base_ts(void);

#endif /* MODBUS_SIM_H */
```

## include/test_runner.h
```c
#ifndef TEST_RUNNER_H
#define TEST_RUNNER_H

#include <stdint.h>
#include "hal.h"

#define MAX_SCENARIOS   8
#define MAX_NAME_LEN    32

typedef struct {
    uint32_t min;
    uint32_t max;
} range_u32_t;

typedef struct {
    uint16_t min;
    uint16_t max;
} range_u16_t;

typedef struct {
    char        name[MAX_NAME_LEN];
    uint32_t    interval_ms;   /* pausa tra TX in ms */
    uint32_t    loops;         /* numero TX per scenario */

    uint8_t     state;         /* fisso — stato macchina */
    range_u32_t pallet_id;     /* range ID pallet */
    range_u16_t wrap_time;     /* range secondi avvolimento */
    range_u16_t wrap_transit;  /* range secondi transito */
    range_u16_t rotations;     /* range rotazioni pallet */
    uint8_t     program_number;/* fisso */
    uint16_t    perimeter;     /* fisso — unità TBD */
    range_u32_t running_secs;  /* range secondi marcia */
    range_u32_t alarm_secs;    /* range secondi allarme */
} test_scenario_t;

typedef struct {
    test_scenario_t scenarios[MAX_SCENARIOS];
    int             count;
} test_config_t;

typedef void (*tx_callback_t)(const hal_sensor_data_t *data,
                               uint16_t seq,
                               const char *scenario_name);

/* SIM_TX_INTERVAL_MS: ms between packets (injected by CMake, default 5 min) */
#ifndef SIM_TX_INTERVAL_MS
#define SIM_TX_INTERVAL_MS 300000U
#endif

int  test_runner_load(test_config_t *cfg);
/* Runs scenarios once then loops forever, sleeping SIM_TX_INTERVAL_MS between packets */
void test_runner_run(const test_config_t *cfg, tx_callback_t on_tx);

uint32_t tr_rand_u32(uint32_t min, uint32_t max);
uint16_t tr_rand_u16(uint16_t min, uint16_t max);

#endif
```

## src/hal_ebyte_uart.c
```c
/*
 * hal_ebyte_uart.c — collector HAL for Ebyte E22-900T22S (UART LoRa module)
 *
 * The T22S is NOT a raw SX1262: it runs Ebyte's own firmware and is driven
 * over UART in transparent mode. Zephyr's LoRa driver (CONFIG_LORA) does not
 * apply here — this HAL talks to the module directly.
 *
 * Wiring (NUCLEO-L073RZ):
 *   E22 RXD <- PA9  (USART1_TX)
 *   E22 TXD -> PA10 (USART1_RX)
 *   E22 M0  <- PC0
 *   E22 M1  <- PC1
 *   E22 AUX -> PC2  (module busy indicator, HIGH = ready)
 *   E22 VCC <- 3.3V, GND <- GND
 *
 * Module modes (M1, M0):    0,0 = transparent TX/RX
 *                           1,0 = configuration (UART fixed 9600 8N1)
 *
 * At boot the HAL enters config mode, reads the registers back (this doubles
 * as a wiring test), writes the working parameters with C2 (volatile — no
 * flash wear), then switches to transparent mode.
 *
 * Radio parameters set here (must be matched by the RAK4631 gateway sniffer):
 *   channel 18 -> 850.125 + 18 = 868.125 MHz, air rate 2.4k, 13 dBm,
 *   transparent mode, sub-packet 240 bytes.
 *
 * If the module does not answer, hal_radio_tx() falls back to printing the
 * hex on the console (same format as hal_sim.c) so the pipeline stays
 * observable while debugging the wiring.
 */

#include "hal.h"
#include "aes_ctr.h"
#include "store_forward.h"
#include "rolling_buffer.h"
#include <zephyr/kernel.h>
#include <zephyr/device.h>
#include <zephyr/drivers/uart.h>
#include <zephyr/drivers/gpio.h>
#include <zephyr/sys/printk.h>
#include <string.h>

static const uint8_t HW_KEY[AES_KEY_SIZE] = {
    0x2B, 0x7E, 0x15, 0x16,
    0x28, 0xAE, 0xD2, 0xA6,
    0xAB, 0xF7, 0x15, 0x88,
    0x09, 0xCF, 0x4F, 0x3C
};

/* ── devices & pins ───────────────────────────────────────────────────── */

#define EBYTE_UART_NODE DT_NODELABEL(usart1)

#if DT_NODE_HAS_STATUS(EBYTE_UART_NODE, okay)
static const struct device *ebyte_uart = DEVICE_DT_GET(EBYTE_UART_NODE);
#else
static const struct device *ebyte_uart;   /* NULL — overlay missing */
#endif

static const struct device *gpio_c = DEVICE_DT_GET(DT_NODELABEL(gpioc));

#define PIN_M0   0   /* PC0 */
#define PIN_M1   1   /* PC1 */
#define PIN_AUX  2   /* PC2 */

#define EBYTE_AUX_TIMEOUT_MS   1000   /* mode switch / idle wait      */
#define EBYTE_TX_TIMEOUT_MS    5000   /* air TX of one 50-byte frame  */
#define EBYTE_CFG_REPLY_MS      500   /* config command response      */

static bool ebyte_ready;

/* ── low-level helpers ────────────────────────────────────────────────── */

/* AUX is HIGH when the module is idle, LOW while busy (self-check, mode
 * switch, processing, on-air TX). Returns 0 on ready, -1 on timeout. */
static int ebyte_wait_aux(int32_t timeout_ms)
{
    int64_t deadline = k_uptime_get() + timeout_ms;
    while (k_uptime_get() < deadline) {
        if (gpio_pin_get(gpio_c, PIN_AUX) > 0) {
            return 0;
        }
        k_msleep(1);
    }
    return -1;
}

static int ebyte_set_mode(int m1, int m0)
{
    gpio_pin_set(gpio_c, PIN_M0, m0);
    gpio_pin_set(gpio_c, PIN_M1, m1);
    k_msleep(2);
    if (ebyte_wait_aux(EBYTE_AUX_TIMEOUT_MS) != 0) {
        return -1;
    }
    /* datasheet: wait >2 ms after AUX rises before using the new mode */
    k_msleep(10);
    return 0;
}

static void ebyte_uart_flush_rx(void)
{
    unsigned char c;
    while (uart_poll_in(ebyte_uart, &c) == 0) {
        /* discard stale bytes */
    }
}

static void ebyte_uart_send(const uint8_t *buf, size_t len)
{
    for (size_t i = 0; i < len; i++) {
        uart_poll_out(ebyte_uart, buf[i]);
    }
}

static int ebyte_uart_recv(uint8_t *buf, size_t len, int32_t timeout_ms)
{
    size_t  got      = 0;
    int64_t deadline = k_uptime_get() + timeout_ms;
    while (got < len && k_uptime_get() < deadline) {
        unsigned char c;
        if (uart_poll_in(ebyte_uart, &c) == 0) {
            buf[got++] = (uint8_t)c;
        }
        /* no sleep: at 9600 baud a byte lands every ~1 ms and the L0
         * USART has a 1-byte buffer — sleeping a tick causes overruns */
    }
    return (int)got;
}

/* ── module configuration (config mode, 9600 8N1) ─────────────────────── */

/* Registers 00h..06h: ADDH ADDL NETID REG0 REG1 REG2 REG3 */
static const uint8_t EBYTE_PARAMS[7] = {
    0x00,   /* ADDH  — address 0x0000                                  */
    0x00,   /* ADDL                                                    */
    0x00,   /* NETID — network 0                                       */
    0x62,   /* REG0  — UART 9600 8N1, air rate 2.4k                    */
    0x02,   /* REG1  — sub-packet 240 B, RSSI noise off, TX 13 dBm     */
    0x12,   /* REG2  — channel 18 = 850.125 + 18 = 868.125 MHz         */
    0x03,   /* REG3  — transparent mode, RSSI byte off, LBT off        */
};

static int ebyte_configure(void)
{
    uint8_t resp[16];
    int     n;

    if (ebyte_set_mode(1, 0) != 0) {        /* mode 2: configuration */
        printk("[HAL COLLECTOR HW] ERROR: AUX stuck low entering config mode\n");
        return -1;
    }
    ebyte_uart_flush_rx();

    /* 1. Read current registers — doubles as a wiring test.
     * At 9600 baud the 10-byte reply takes ~10 ms; wait 20 ms before reading
     * so the USART buffer has all bytes ready and we don't miss the first one. */
    const uint8_t cmd_read[3] = { 0xC1, 0x00, 0x07 };
    ebyte_uart_send(cmd_read, sizeof(cmd_read));
    n = ebyte_uart_recv(resp, 10, EBYTE_CFG_REPLY_MS);
    printk("[HAL COLLECTOR HW] E22 read reply: got %d bytes:", n);
    for (int i = 0; i < n; i++) printk(" %02X", resp[i]);
    printk("\n");
    if (n < 3 || resp[0] != 0xC1) {
        printk("[HAL COLLECTOR HW] ERROR: E22 not responding (got %d bytes)\n", n);
        printk("[HAL COLLECTOR HW] Check wiring: PA9->RXD, PA10<-TXD, M0=PC0, M1=PC1\n");
        return -1;
    }
    printk("[HAL COLLECTOR HW] E22 factory regs: "
           "addr=%02X%02X net=%02X reg0=%02X reg1=%02X ch=%u reg3=%02X\n",
           resp[3], resp[4], resp[5], resp[6], resp[7], resp[8], resp[9]);

    /* 2. Write working parameters (C2 = volatile, no flash wear) */
    uint8_t cmd_write[3 + sizeof(EBYTE_PARAMS)] = { 0xC2, 0x00, 0x07 };
    memcpy(&cmd_write[3], EBYTE_PARAMS, sizeof(EBYTE_PARAMS));
    ebyte_uart_flush_rx();
    ebyte_uart_send(cmd_write, sizeof(cmd_write));
    n = ebyte_uart_recv(resp, 10, EBYTE_CFG_REPLY_MS);
    if (n < 10 || resp[0] != 0xC1 ||
        memcmp(&resp[3], EBYTE_PARAMS, sizeof(EBYTE_PARAMS)) != 0) {
        printk("[HAL COLLECTOR HW] ERROR: E22 config write failed (got %d bytes)\n", n);
        return -1;
    }
    printk("[HAL COLLECTOR HW] E22 configured: 868.125 MHz, air 2.4k, 13 dBm, transparent\n");

    /* 3. Back to mode 0: transparent transmission */
    if (ebyte_set_mode(0, 0) != 0) {
        printk("[HAL COLLECTOR HW] ERROR: AUX stuck low entering TX mode\n");
        return -1;
    }
    return 0;
}

/* ── init ─────────────────────────────────────────────────────────────── */

int hal_init(void)
{
    printk("[HAL COLLECTOR HW] Initializing (Ebyte E22-900T22S via USART1)\n");

    if (aes_ctr_init(HW_KEY, AES_KEY_SIZE) != 0) {
        printk("[HAL COLLECTOR HW] ERROR: AES init failed\n");
        return SG_HAL_ERROR;
    }

    rolling_buffer_init();
    sf_init();

    if (ebyte_uart == NULL || !device_is_ready(ebyte_uart)) {
        printk("[HAL COLLECTOR HW] USART1 not ready — TX will print hex\n");
        return SG_HAL_OK;
    }
    if (!device_is_ready(gpio_c)) {
        printk("[HAL COLLECTOR HW] GPIOC not ready — TX will print hex\n");
        return SG_HAL_OK;
    }

    gpio_pin_configure(gpio_c, PIN_M0,  GPIO_OUTPUT_INACTIVE);
    gpio_pin_configure(gpio_c, PIN_M1,  GPIO_OUTPUT_INACTIVE);
    gpio_pin_configure(gpio_c, PIN_AUX, GPIO_INPUT);

    /* power-on self check: AUX stays low up to ~100 ms after power-up */
    k_msleep(100);

    if (ebyte_configure() == 0) {
        ebyte_ready = true;
    } else {
        printk("[HAL COLLECTOR HW] E22 unavailable — TX will print hex\n");
    }

    printk("[HAL COLLECTOR HW] Ready\n");
    return SG_HAL_OK;
}

/* ── flash (store-and-forward) ────────────────────────────────────────── */

int hal_flash_write(const uint8_t *packet, size_t len)
{
    if (len != SF_SLOT_SIZE) return SG_HAL_ERROR;
    return (sf_write(packet) == SF_OK) ? SG_HAL_OK : SG_HAL_FULL;
}

int hal_flash_read(uint8_t *packet, size_t len)
{
    if (len != SF_SLOT_SIZE) return SG_HAL_ERROR;
    return (sf_read(packet) == SF_OK) ? SG_HAL_OK : SG_HAL_EMPTY;
}

int hal_flash_pending(void)
{
    return sf_pending();
}

/* ── radio TX ─────────────────────────────────────────────────────────── */

int hal_radio_tx(const uint8_t *packet, size_t len)
{
    if (ebyte_ready) {
        if (ebyte_wait_aux(EBYTE_AUX_TIMEOUT_MS) != 0) {
            printk("[HAL COLLECTOR HW] ERROR: E22 busy, TX skipped\n");
            return SG_HAL_ERROR;
        }

        /* transparent mode: bytes written to the UART go straight on air
         * as one LoRa frame (len < 240-byte sub-packet) */
        ebyte_uart_send(packet, len);

        /* AUX drops while the frame is on air, rises when TX completes */
        k_msleep(10);
        if (ebyte_wait_aux(EBYTE_TX_TIMEOUT_MS) != 0) {
            printk("[HAL COLLECTOR HW] ERROR: E22 TX timeout\n");
            return SG_HAL_ERROR;
        }
        printk("[HAL COLLECTOR HW] E22 LoRa TX %d bytes sent\n", (int)len);
        return SG_HAL_OK;
    }

    /* fallback: same format as hal_sim.c so sim_bridge.py still works */
    printk("[HAL COLLECTOR SIM] LoRa TX %d bytes: ", (int)len);
    for (size_t i = 0; i < len; i++) {
        printk("%02X", packet[i]);
    }
    printk("\n");
    return SG_HAL_OK;
}

/* ── crypto ───────────────────────────────────────────────────────────── */

int hal_crypto_get_key(uint8_t *key_out, size_t key_len)
{
    /*
     * On real hardware: atcab_read_zone(ATCA_ZONE_DATA, KEY_SLOT, ...) via I2C.
     * Returns the hardcoded key until ATECC608B driver is wired.
     */
    if (key_len != AES_KEY_SIZE) return SG_HAL_ERROR;
    memcpy(key_out, HW_KEY, AES_KEY_SIZE);
    return SG_HAL_OK;
}

void hal_crypto_make_nonce(uint8_t *nonce_out,
                           uint8_t  device_id,
                           uint16_t seq)
{
    memset(nonce_out, 0, AES_NONCE_SIZE);
    nonce_out[0] = device_id;
    nonce_out[1] = (seq >> 8) & 0xFF;
    nonce_out[2] = seq & 0xFF;
}

/* ── sensor ───────────────────────────────────────────────────────────────
 * hal_sensor_read() is NOT implemented here — test_runner generates data
 * directly. Weak stub keeps the linker satisfied if something references it.
 */
__attribute__((weak))
int hal_sensor_read(hal_sensor_data_t *data, uint16_t seq)
{
    (void)data; (void)seq;
    printk("[HAL COLLECTOR HW] hal_sensor_read: no implementation linked\n");
    return SG_HAL_ERROR;
}
```

## src/hal_hw.c
```c
/* =============================================================
 * HAL HW — Siemens SIMATIC ET 200SP CPU 1510SP-1 PN
 * Communication: Modbus RTU via CM PtP RS485 module
 *
 * TIA Portal configuration required:
 *   1. Add CM PtP RS485 module to ET 200SP hardware config
 *   2. Enable Modbus RTU master/slave mode on CM PtP
 *   3. Baud rate: 9600 bps (confirm with Technowrapp)
 *   4. Parity: None, 8 data bits, 1 stop bit (8N1)
 *   5. Slave address: 1 (confirm with Technowrapp)
 *   6. Map PLC data blocks to holding registers 40001-40014:
 *      40001 = machine state code
 *      40002-3 = pallet_id (uint32 split high/low)
 *      40004 = wrap_time (seconds)
 *      40005 = wrap_transit_time (seconds)
 *      40006 = pallet_rotations
 *      40007 = program_number
 *      40008 = pallet_perimeter
 *      40009-10 = running_seconds (uint32 split high/low)
 *      40011-12 = alarm_seconds (uint32 split high/low)
 *      40013-14 = machine_timestamp Unix epoch (uint32 high/low)
 *
 * Physical connection:
 *   STM32L073 UART2 TX → MAX3485 DI
 *   STM32L073 UART2 RX → MAX3485 RO
 *   STM32L073 PA1      → MAX3485 DE+RE (direction control)
 *   MAX3485 A/B        → RS-485 cable → CM PtP RS485 terminal
 * ============================================================= */

#include "hal.h"
#include "aes_ctr.h"
#include "store_forward.h"
#include "rolling_buffer.h"
#include "modbus_sim.h"

#include <zephyr/modbus/modbus.h>
#include <zephyr/kernel.h>
#include <zephyr/sys/printk.h>
#include <string.h>

/* TODO: Confirm slave address with Technowrapp */
#define MODBUS_SLAVE_ADDR   1

/* TODO: Set to the UART device label for the RS-485 port on RAK4630.
 * On RAK4630: UART1 = "UART_1", UART2 = "UART_2" — confirm in devicetree. */
#define MODBUS_UART_DEV     "UART_1"

/* TODO: Confirm baud rate with Technowrapp (9600 or 19200) */
#define MODBUS_BAUD         9600

/* Modbus RTU timeout — 1.5× character time at 9600 bps ≈ 2 ms; use 50 ms for margin */
#define MODBUS_TIMEOUT_MS   50

/* AES-128 key — must match hal_sim.c / firmware exactly */
static const uint8_t HW_KEY[AES_KEY_SIZE] = {
    0x2B, 0x7E, 0x15, 0x16,
    0x28, 0xAE, 0xD2, 0xA6,
    0xAB, 0xF7, 0x15, 0x88,
    0x09, 0xCF, 0x4F, 0x3C
};

/* Modbus client interface handle */
static int modbus_iface = -1;


/* ── hal_init ────────────────────────────────────────────────────────────────*/

int hal_init(void)
{
    printk("[HAL HW] Initializing — Modbus RTU master on %s\n", MODBUS_UART_DEV);

    /* TODO: Replace "UART_1" with the actual Zephyr device node label.
     * Check your board's .dts or .overlay file: look for uart@... aliases. */
    struct modbus_iface_param params = {
        .mode           = MODBUS_MODE_RTU,
        .rx_timeout     = K_MSEC(MODBUS_TIMEOUT_MS),
        .serial = {
            .baud       = MODBUS_BAUD,
            .parity     = UART_CFG_PARITY_NONE,
            /* TODO: verify flow control — DE/RE on PA1 is handled by the
             * Zephyr RS-485 driver if you set rs485_de_active_high in DTS. */
        },
    };

    modbus_iface = modbus_iface_get_by_name(MODBUS_UART_DEV);
    if (modbus_iface < 0) {
        printk("[HAL HW] ERROR: Modbus iface not found: %s\n", MODBUS_UART_DEV);
        return HAL_ERROR;
    }

    int rc = modbus_init_client(modbus_iface, params);
    if (rc != 0) {
        printk("[HAL HW] ERROR: modbus_init_client failed: %d\n", rc);
        return HAL_ERROR;
    }

    if (aes_ctr_init(HW_KEY, AES_KEY_SIZE) != 0) {
        printk("[HAL HW] ERROR: AES init failed\n");
        return HAL_ERROR;
    }

    rolling_buffer_init();
    sf_init();

    printk("[HAL HW] Ready — slave addr=%d baud=%d\n", MODBUS_SLAVE_ADDR, MODBUS_BAUD);
    return HAL_OK;
}


/* ── hal_sensor_read ─────────────────────────────────────────────────────────*/

int hal_sensor_read(hal_sensor_data_t *data, uint16_t seq)
{
    uint16_t regs[MB_NUM_REGS] = {0};

    /* FC03: Read MB_NUM_REGS holding registers starting at address 0 (40001) */
    int rc = modbus_read_holding_regs(
        modbus_iface,
        MODBUS_SLAVE_ADDR,
        0,          /* start address — 40001 in PLC = address 0 in Modbus frame */
        regs,
        MB_NUM_REGS
    );

    if (rc != 0) {
        printk("[HAL HW] ERROR: Modbus FC03 failed (rc=%d) seq=%u\n", rc, seq);
        return HAL_ERROR;
    }

    /* Unpack registers — same mapping as modbus_sim.h */
    data->state = (uint8_t)regs[MB_REG_STATE];

    data->pallet_id = ((uint32_t)regs[MB_REG_PALLET_HIGH] << 16)
                    | regs[MB_REG_PALLET_LOW];

    data->wrap_time         = regs[MB_REG_WRAP_TIME];
    data->wrap_transit_time = regs[MB_REG_WRAP_TRANSIT];
    data->pallet_rotations  = regs[MB_REG_ROTATIONS];
    data->program_number    = (uint8_t)regs[MB_REG_PROGRAM];
    data->pallet_perimeter  = regs[MB_REG_PERIMETER];

    data->running_seconds = ((uint32_t)regs[MB_REG_RUN_HIGH] << 16)
                          | regs[MB_REG_RUN_LOW];

    data->alarm_seconds   = ((uint32_t)regs[MB_REG_ALARM_HIGH] << 16)
                          | regs[MB_REG_ALARM_LOW];

    data->machine_timestamp = ((uint32_t)regs[MB_REG_TS_HIGH] << 16)
                            | regs[MB_REG_TS_LOW];

    if (data->state == 99) {
        printk("[HAL HW] WARNING: machine OFFLINE (seq=%u)\n", seq);
    }

    return HAL_OK;
}


/* ── hal_flash_write ─────────────────────────────────────────────────────────*/

int hal_flash_write(const uint8_t *packet, size_t len)
{
    if (len != SF_SLOT_SIZE) return HAL_ERROR;
    return (sf_write(packet) == SF_OK) ? HAL_OK : HAL_FULL;
}


/* ── hal_flash_read ──────────────────────────────────────────────────────────*/

int hal_flash_read(uint8_t *packet, size_t len)
{
    if (len != SF_SLOT_SIZE) return HAL_ERROR;
    return (sf_read(packet) == SF_OK) ? HAL_OK : HAL_EMPTY;
}


/* ── hal_flash_pending ───────────────────────────────────────────────────────*/

int hal_flash_pending(void)
{
    return sf_pending();
}


/* ── hal_radio_tx ────────────────────────────────────────────────────────────*/

int hal_radio_tx(const uint8_t *packet, size_t len)
{
    /* TODO: Replace printk stub with real LoRa TX once RAK4630 radio driver
     * is confirmed. Use: lora_send(&lora_dev, packet, len, false)
     * Device node: &lora0 in RAK4630 DTS. */
    printk("[HAL HW] LoRa TX %d bytes: ", (int)len);
    for (size_t i = 0; i < len; i++) {
        printk("%02X", packet[i]);
    }
    printk("\n");
    return HAL_OK;
}


/* ── hal_crypto_get_key ──────────────────────────────────────────────────────*/

int hal_crypto_get_key(uint8_t *key_out, size_t key_len)
{
    /* TODO: Replace hardcoded key with ATECC608B secure-element read:
     *   atcab_read_zone(ATCA_ZONE_DATA, KEY_SLOT, 0, 0, key_out, key_len)
     * For initial bring-up the hardcoded key is used. */
    if (key_len != AES_KEY_SIZE) return HAL_ERROR;
    memcpy(key_out, HW_KEY, AES_KEY_SIZE);
    return HAL_OK;
}


/* ── hal_crypto_make_nonce ───────────────────────────────────────────────────*/

void hal_crypto_make_nonce(uint8_t *nonce_out,
                           uint8_t  device_id,
                           uint16_t seq)
{
    /* Layout: [device_id 1B][seq high 1B][seq low 1B][zeros 13B]
     * Must stay in sync with aes_decrypt.py _build_nonce(). */
    memset(nonce_out, 0, AES_NONCE_SIZE);
    nonce_out[0] = device_id;
    nonce_out[1] = (seq >> 8) & 0xFF;
    nonce_out[2] = seq & 0xFF;
}
```

## src/hal_lora.c
```c
/*
 * hal_lora.c — collector HAL, real hardware implementation
 *
 * Drop-in replacement for hal_sim.c targeting actual Cortex-M hardware.
 * To activate:
 *   1. In CMakeLists.txt replace hal_sim.c with hal_lora.c
 *   2. In prj.conf uncomment CONFIG_LORA=y (and CONFIG_MODBUS=y for sensor)
 *   3. Add a board overlay with the lora0 DTS alias
 *
 * In QEMU (qemu_cortex_m3) the LoRa device is never ready, so
 * hal_radio_tx() prints the hex to console exactly as hal_sim.c does —
 * no functional regression in simulation.
 */

#include "hal.h"
#include "aes_ctr.h"
#include "store_forward.h"
#include "rolling_buffer.h"
#include "lora_link.h"
#include <zephyr/kernel.h>
#include <zephyr/device.h>
#include <zephyr/drivers/lora.h>
#include <zephyr/sys/printk.h>
#include <string.h>

static const uint8_t HW_KEY[AES_KEY_SIZE] = {
    0x2B, 0x7E, 0x15, 0x16,
    0x28, 0xAE, 0xD2, 0xA6,
    0xAB, 0xF7, 0x15, 0x88,
    0x09, 0xCF, 0x4F, 0x3C
};

#if DT_HAS_ALIAS(lora0)
static const struct device *lora_dev = DEVICE_DT_GET(LORA_NODE);
#else
static const struct device *lora_dev;   /* NULL — no LoRa node in DTS */
#endif

static bool lora_ready;

/* ── init ──────────────────────────────────────────────────────────────── */

int hal_init(void)
{
    printk("[HAL COLLECTOR HW] Initializing\n");

    if (aes_ctr_init(HW_KEY, AES_KEY_SIZE) != 0) {
        printk("[HAL COLLECTOR HW] ERROR: AES init failed\n");
        return HAL_ERROR;
    }

    rolling_buffer_init();
    sf_init();

#if DT_HAS_ALIAS(lora0)
    lora_ready = device_is_ready(lora_dev);
#else
    lora_ready = false;
#endif

    if (lora_ready) {
        struct lora_modem_config cfg = {
            .frequency    = LORA_FREQUENCY,
            .bandwidth    = LORA_BANDWIDTH,
            .datarate     = LORA_DATARATE,
            .coding_rate  = LORA_CODING_RATE,
            .preamble_len = LORA_PREAMBLE_LEN,
            .tx_power     = LORA_TX_POWER,
            .tx           = true,
        };
        if (lora_config(lora_dev, &cfg) != 0) {
            printk("[HAL COLLECTOR HW] ERROR: lora_config failed\n");
            lora_ready = false;
        } else {
            printk("[HAL COLLECTOR HW] LoRa configured @ %d Hz SF%d\n",
                   LORA_FREQUENCY, 10);
        }
    } else {
        printk("[HAL COLLECTOR HW] LoRa device not ready (QEMU?) — TX will print hex\n");
    }

    printk("[HAL COLLECTOR HW] Ready\n");
    return HAL_OK;
}

/* ── flash (store-and-forward) ─────────────────────────────────────────── */

int hal_flash_write(const uint8_t *packet, size_t len)
{
    if (len != SF_SLOT_SIZE) return HAL_ERROR;
    return (sf_write(packet) == SF_OK) ? HAL_OK : HAL_FULL;
}

int hal_flash_read(uint8_t *packet, size_t len)
{
    if (len != SF_SLOT_SIZE) return HAL_ERROR;
    return (sf_read(packet) == SF_OK) ? HAL_OK : HAL_EMPTY;
}

int hal_flash_pending(void)
{
    return sf_pending();
}

/* ── radio TX ──────────────────────────────────────────────────────────── */

int hal_radio_tx(const uint8_t *packet, size_t len)
{
    if (lora_ready) {
        int ret = lora_send(lora_dev, (uint8_t *)packet, len);
        if (ret != 0) {
            printk("[HAL COLLECTOR HW] ERROR: lora_send failed (%d)\n", ret);
            return HAL_ERROR;
        }
        printk("[HAL COLLECTOR HW] LoRa TX %d bytes sent\n", (int)len);
        return HAL_OK;
    }

    /* QEMU fallback: same format as hal_sim.c so sim_bridge.py still works */
    printk("[HAL COLLECTOR SIM] LoRa TX %d bytes: ", (int)len);
    for (size_t i = 0; i < len; i++) {
        printk("%02X", packet[i]);
    }
    printk("\n");
    return HAL_OK;
}

/* ── crypto ────────────────────────────────────────────────────────────── */

int hal_crypto_get_key(uint8_t *key_out, size_t key_len)
{
    /*
     * On real hardware: atcab_read_zone(ATCA_ZONE_DATA, KEY_SLOT, ...) via I2C.
     * Returns the hardcoded key until ATECC608B driver is wired.
     */
    if (key_len != AES_KEY_SIZE) return HAL_ERROR;
    memcpy(key_out, HW_KEY, AES_KEY_SIZE);
    return HAL_OK;
}

void hal_crypto_make_nonce(uint8_t *nonce_out,
                           uint8_t  device_id,
                           uint16_t seq)
{
    memset(nonce_out, 0, AES_NONCE_SIZE);
    nonce_out[0] = device_id;
    nonce_out[1] = (seq >> 8) & 0xFF;
    nonce_out[2] = seq & 0xFF;
}

/* ── sensor (Modbus RTU) ────────────────────────────────────────────────
 * hal_sensor_read() is NOT implemented here — use modbus_sim.c in QEMU
 * or hal_hw.c (Modbus RTU master) on real hardware.
 * Provide a weak stub so the linker is satisfied when this file is used
 * standalone in QEMU without hal_hw.c.
 */
__attribute__((weak))
int hal_sensor_read(hal_sensor_data_t *data, uint16_t seq)
{
    (void)data; (void)seq;
    printk("[HAL COLLECTOR HW] hal_sensor_read: no implementation linked\n");
    return HAL_ERROR;
}
```

## src/hal_sim.c
```c
#include "hal.h"
#include "aes_ctr.h"
#include "store_forward.h"
#include "rolling_buffer.h"
#include "modbus_sim.h"
#include <string.h>
#include <zephyr/sys/printk.h>

static const uint8_t SIM_KEY[AES_KEY_SIZE] = {
    0x2B, 0x7E, 0x15, 0x16,
    0x28, 0xAE, 0xD2, 0xA6,
    0xAB, 0xF7, 0x15, 0x88,
    0x09, 0xCF, 0x4F, 0x3C
};

int hal_init(void)
{
    printk("[HAL COLLECTOR SIM] Initializing\n");

    if (aes_ctr_init(SIM_KEY, AES_KEY_SIZE) != 0) {
        printk("[HAL COLLECTOR SIM] ERROR: AES init failed\n");
        return SG_HAL_ERROR;
    }

    rolling_buffer_init();
    sf_init();
    modbus_sim_init();

    printk("[HAL COLLECTOR SIM] Ready\n");
    return SG_HAL_OK;
}

int hal_sensor_read(hal_sensor_data_t *data, uint16_t seq)
{
    /* Update simulated registers before reading */
    modbus_sim_tick(seq);

    uint16_t regs[MB_NUM_REGS];
    if (modbus_sim_read_registers(regs, MB_NUM_REGS) != 0) {
        printk("[HAL COLLECTOR SIM] ERROR: Modbus read failed\n");
        return SG_HAL_ERROR;
    }

    data->state = (uint8_t)regs[MB_REG_STATE];

    data->pallet_id = ((uint32_t)regs[MB_REG_PALLET_HIGH] << 16)
                    | regs[MB_REG_PALLET_LOW];

    data->wrap_time         = regs[MB_REG_WRAP_TIME];
    data->wrap_transit_time = regs[MB_REG_WRAP_TRANSIT];
    data->pallet_rotations  = regs[MB_REG_ROTATIONS];
    data->program_number    = (uint8_t)regs[MB_REG_PROGRAM];
    data->pallet_perimeter  = regs[MB_REG_PERIMETER];

    data->running_seconds = ((uint32_t)regs[MB_REG_RUN_HIGH] << 16)
                          | regs[MB_REG_RUN_LOW];

    data->alarm_seconds   = ((uint32_t)regs[MB_REG_ALARM_HIGH] << 16)
                          | regs[MB_REG_ALARM_LOW];

    data->machine_timestamp = ((uint32_t)regs[MB_REG_TS_HIGH] << 16)
                            | regs[MB_REG_TS_LOW];

    if (data->state == 99) {
        printk("[HAL COLLECTOR SIM] WARNING: machine OFFLINE\n");
    }

    return SG_HAL_OK;
}

int hal_flash_write(const uint8_t *packet, size_t len)
{
    if (len != SF_SLOT_SIZE) return SG_HAL_ERROR;
    return (sf_write(packet) == SF_OK) ? SG_HAL_OK : SG_HAL_FULL;
}

int hal_flash_read(uint8_t *packet, size_t len)
{
    if (len != SF_SLOT_SIZE) return SG_HAL_ERROR;
    return (sf_read(packet) == SF_OK) ? SG_HAL_OK : SG_HAL_EMPTY;
}

int hal_flash_pending(void)
{
    return sf_pending();
}

int hal_radio_tx(const uint8_t *packet, size_t len)
{
    /*
     * Simulates LoRa TX to gateway.
     * Later: lora_send(&lora_dev, packet, len, false)
     */
    printk("[HAL COLLECTOR SIM] LoRa TX %d bytes: ", len);
    for (size_t i = 0; i < len; i++) {
        printk("%02X", packet[i]);
    }
    printk("\n");
    return SG_HAL_OK;
}

int hal_crypto_get_key(uint8_t *key_out, size_t key_len)
{
    /*
     * Returns hardcoded key.
     * Later: atcab_read_zone() on ATECC608B via I2C
     */
    if (key_len != AES_KEY_SIZE) return SG_HAL_ERROR;
    memcpy(key_out, SIM_KEY, AES_KEY_SIZE);
    return SG_HAL_OK;
}

void hal_crypto_make_nonce(uint8_t *nonce_out,
                           uint8_t  device_id,
                           uint16_t seq)
{
    memset(nonce_out, 0, AES_NONCE_SIZE);
    nonce_out[0] = device_id;
    nonce_out[1] = (seq >> 8) & 0xFF;
    nonce_out[2] = seq & 0xFF;
}
```

## src/modbus_sim.c
```c
#include "modbus_sim.h"
#include <string.h>
#include <zephyr/sys/printk.h>

static uint16_t sim_regs[MB_NUM_REGS];

/* Injected by CMake at build time via target_compile_definitions() */
#ifndef SIM_BUILD_TS
#define SIM_BUILD_TS 1774138000U
#endif
static uint32_t sim_base_ts = SIM_BUILD_TS;

void modbus_sim_init(void)
{
    printk("[MODBUS SIM] Base timestamp: %u\n", sim_base_ts);

    sim_regs[MB_REG_STATE]        = 30;
    sim_regs[MB_REG_PALLET_HIGH]  = (159307 >> 16) & 0xFFFF;
    sim_regs[MB_REG_PALLET_LOW]   = 159307 & 0xFFFF;
    sim_regs[MB_REG_WRAP_TIME]    = 458;
    sim_regs[MB_REG_WRAP_TRANSIT] = 710;
    sim_regs[MB_REG_ROTATIONS]    = 15;
    sim_regs[MB_REG_PROGRAM]      = 0;
    sim_regs[MB_REG_PERIMETER]    = 3;
    sim_regs[MB_REG_RUN_HIGH]     = 0;
    sim_regs[MB_REG_RUN_LOW]      = 4000;
    sim_regs[MB_REG_ALARM_HIGH]   = 0;
    sim_regs[MB_REG_ALARM_LOW]    = 0;
    sim_regs[MB_REG_TS_HIGH]      = (sim_base_ts >> 16) & 0xFFFF;
    sim_regs[MB_REG_TS_LOW]       = sim_base_ts & 0xFFFF;
}

void modbus_sim_tick(uint16_t seq)
{
    /*
     * Simulates realistic machine activity on each poll cycle.
     * Production: this block does not exist —
     * values are read directly from the PLC via UART Modbus RTU.
     */
    sim_regs[MB_REG_STATE] = ((seq % 20) < 10) ? 30 : 31;

    uint32_t pallet_id = 159307 + (seq / 10);
    sim_regs[MB_REG_PALLET_HIGH] = (pallet_id >> 16) & 0xFFFF;
    sim_regs[MB_REG_PALLET_LOW]  = pallet_id & 0xFFFF;

    sim_regs[MB_REG_WRAP_TIME]    = 450 + (seq % 30);
    sim_regs[MB_REG_WRAP_TRANSIT] = 700 + (seq % 50);
    sim_regs[MB_REG_ROTATIONS]    = 820 + (seq % 20);
    sim_regs[MB_REG_PROGRAM]      = 15;
    sim_regs[MB_REG_PERIMETER]    = 3;

    uint32_t run_s = (uint32_t)seq * 60;
    sim_regs[MB_REG_RUN_HIGH] = (run_s >> 16) & 0xFFFF;
    sim_regs[MB_REG_RUN_LOW]  = run_s & 0xFFFF;

    uint32_t alarm_s = (seq > 5) ? (seq - 5) * 2 : 0;
    sim_regs[MB_REG_ALARM_HIGH] = (alarm_s >> 16) & 0xFFFF;
    sim_regs[MB_REG_ALARM_LOW]  = alarm_s & 0xFFFF;

    uint32_t ts = sim_base_ts + (uint32_t)seq * 60;
    sim_regs[MB_REG_TS_HIGH] = (ts >> 16) & 0xFFFF;
    sim_regs[MB_REG_TS_LOW]  = ts & 0xFFFF;
}

uint32_t modbus_sim_base_ts(void)
{
    return sim_base_ts;
}

int modbus_sim_read_registers(uint16_t *regs, uint8_t count)
{
    if (count > MB_NUM_REGS) return -1;
    memcpy(regs, sim_regs, count * sizeof(uint16_t));
    return 0;
}
```

## src/test_runner.c
```c
#include "test_runner.h"
#include "modbus_sim.h"
#include <zephyr/kernel.h>
#include <zephyr/sys/printk.h>
#include <string.h>

/* ── LCG random ─────────────────────────────────────────── */
static uint32_t rng_state;

static uint32_t lcg_next(void)
{
    rng_state = rng_state * 1664525u + 1013904223u;
    return rng_state;
}

uint32_t tr_rand_u32(uint32_t min, uint32_t max)
{
    if (min >= max) return min;
    return min + (lcg_next() % (max - min + 1));
}

uint16_t tr_rand_u16(uint16_t min, uint16_t max)
{
    return (uint16_t)tr_rand_u32(min, max);
}

/* ── Scenario definitions ───────────────────────────────── */
int test_runner_load(test_config_t *cfg)
{
    memset(cfg, 0, sizeof(test_config_t));
    test_scenario_t *s;

    /* ── Scenario 1: Normal production (valori tipici dal dataset) ── */
    s = &cfg->scenarios[0];
    strncpy(s->name, "Normal production", MAX_NAME_LEN);
    s->interval_ms    = 0;
    s->loops          = 5;
    s->state          = 30;
    s->pallet_id      = (range_u32_t){159290, 159307};
    s->wrap_time      = (range_u16_t){400, 780};
    s->wrap_transit   = (range_u16_t){650, 1035};
    s->rotations      = (range_u16_t){13, 25};
    s->program_number = 0;     /* sempre 0 dai dati reali */
    s->perimeter      = 3;     /* sempre 3 dai dati reali */
    s->running_secs   = (range_u32_t){4000, 4000}; /* fisso nei dati */
    s->alarm_secs     = (range_u32_t){0, 0};

    /* ── Scenario 2: Slow pallet (wrap_time alto ma normale) ── */
    s = &cfg->scenarios[1];
    strncpy(s->name, "Slow pallet", MAX_NAME_LEN);
    s->interval_ms    = 0;
    s->loops          = 4;
    s->state          = 30;
    s->pallet_id      = (range_u32_t){159270, 159290};
    s->wrap_time      = (range_u16_t){700, 780};
    s->wrap_transit   = (range_u16_t){950, 1035};
    s->rotations      = (range_u16_t){23, 25};
    s->program_number = 0;
    s->perimeter      = 3;
    s->running_secs   = (range_u32_t){4000, 4000};
    s->alarm_secs     = (range_u32_t){0, 0};

    /* ── Scenario 3: Anomaly (valori anomali reali dal dataset) ── */
    s = &cfg->scenarios[2];
    strncpy(s->name, "Anomaly - pallet stuck", MAX_NAME_LEN);
    s->interval_ms    = 0;
    s->loops          = 3;
    s->state          = 31;
    s->pallet_id      = (range_u32_t){159200, 159270};
    s->wrap_time      = (range_u16_t){18000, 24060}; /* valori anomali reali */
    s->wrap_transit   = (range_u16_t){18200, 24312};
    s->rotations      = (range_u16_t){11, 16};
    s->program_number = 0;
    s->perimeter      = 3;
    s->running_secs   = (range_u32_t){4000, 4000};
    s->alarm_secs     = (range_u32_t){100, 500};

    /* ── Scenario 4: Machine offline ── */
    s = &cfg->scenarios[3];
    strncpy(s->name, "Machine offline", MAX_NAME_LEN);
    s->interval_ms    = 0;
    s->loops          = 2;
    s->state          = 99;
    s->pallet_id      = (range_u32_t){158308, 158308};
    s->wrap_time      = (range_u16_t){0, 0};
    s->wrap_transit   = (range_u16_t){0, 0};
    s->rotations      = (range_u16_t){0, 0};
    s->program_number = 0;
    s->perimeter      = 3;
    s->running_secs   = (range_u32_t){4000, 4000};
    s->alarm_secs     = (range_u32_t){0, 0};

    cfg->count = 4;

    printk("[TEST RUNNER] Loaded %d scenarios\n", cfg->count);
    return 0;
}

/* ── Runner ─────────────────────────────────────────────── */
void test_runner_run(const test_config_t *cfg, tx_callback_t on_tx)
{
    printk("\n[TEST RUNNER] Starting — %d scenarios, interval=%u ms\n\n",
           cfg->count, (unsigned)SIM_TX_INTERVAL_MS);

    uint16_t global_seq = 0;
    uint32_t base_ts    = modbus_sim_base_ts();
    rng_state = base_ts ^ (uint32_t)k_uptime_get();
    uint32_t cycle      = 0;

    while (1) {
        for (int s = 0; s < cfg->count; s++) {
            const test_scenario_t *sc = &cfg->scenarios[s];

            for (uint32_t loop = 0; loop < sc->loops; loop++) {

                hal_sensor_data_t data;

                data.state             = sc->state;
                data.pallet_id         = tr_rand_u32(sc->pallet_id.min,
                                                      sc->pallet_id.max);
                data.wrap_time         = tr_rand_u16(sc->wrap_time.min,
                                                      sc->wrap_time.max);
                data.wrap_transit_time = tr_rand_u16(sc->wrap_transit.min,
                                                      sc->wrap_transit.max);
                data.pallet_rotations  = tr_rand_u16(sc->rotations.min,
                                                      sc->rotations.max);
                data.program_number    = sc->program_number;
                data.pallet_perimeter  = sc->perimeter;
                data.running_seconds   = tr_rand_u32(sc->running_secs.min,
                                                      sc->running_secs.max);
                data.alarm_seconds     = tr_rand_u32(sc->alarm_secs.min,
                                                      sc->alarm_secs.max);
                /* advance machine clock by SIM_TX_INTERVAL_MS per packet */
                data.machine_timestamp = base_ts
                    + (uint32_t)global_seq * (SIM_TX_INTERVAL_MS / 1000U);

                printk("[%s] TX #%u (cycle=%u) state=%u pallet=%lu\n",
                       sc->name, global_seq, cycle,
                       data.state, (unsigned long)data.pallet_id);

                on_tx(&data, global_seq, sc->name);
                global_seq++;

                /* pace transmissions — on real radio this also keeps the
                 * 868 MHz duty cycle under control */
                k_msleep(SIM_TX_INTERVAL_MS);
            }
        }
        cycle++;
    }
}
```
